## package/optee-client/Config.in
```kconfig
config BR2_PACKAGE_OPTEE_CLIENT
	bool "optee-client"
	depends on BR2_TOOLCHAIN_HAS_THREADS
	depends on !BR2_STATIC_LIBS # dlfcn.h
	depends on BR2_TOOLCHAIN_HEADERS_AT_LEAST_4_3 # MMC_IOC_MULTI_CMD
	help
	  Enable the OP-TEE client package that brings non-secure
	  client application resources for OP-TEE support. OP-TEE
	  client is a component delivered by the OP-TEE project.

	  The client API library allows application to invoke trusted
	  applications hosted in the OP-TEE OS secure world.  The
	  supplicant provides services hosted by the non-secure world
	  and invoked by the secure world.

	  https://github.com/OP-TEE/optee_client

if BR2_PACKAGE_OPTEE_CLIENT


config BR2_PACKAGE_OPTEE_CLIENT_CFG_TEE_BENCHMARK
	bool
	default y
	help
	  Include benchmarking

choice
	prompt "OP-TEE Client version"
	default BR2_PACKAGE_OPTEE_CLIENT_LATEST
	help
	  Select the version of OP-TEE OS you want to use

config BR2_PACKAGE_OPTEE_CLIENT_LATEST
	bool "origin/master"
	help
	  Use the latest release tag from the OP-TEE OS official Git
	  repository.

config BR2_PACKAGE_OPTEE_CLIENT_CUSTOM_GIT
	bool "Custom Git repository"
	help
	  Use a custom version fetched from a Git repository.

endchoice

if BR2_PACKAGE_OPTEE_CLIENT_CUSTOM_GIT

config BR2_PACKAGE_OPTEE_CLIENT_CUSTOM_REPO_URL
	string "URL of custom repository"
	depends on BR2_PACKAGE_OPTEE_CLIENT_CUSTOM_GIT
	help
	  Specific location of the reference source tree Git
	  repository.

config BR2_PACKAGE_OPTEE_CLIENT_CUSTOM_REPO_VERSION
	string "Custom repository version"
	depends on BR2_PACKAGE_OPTEE_CLIENT_CUSTOM_GIT
	help
	  Revision to use in the typical format used by Git, i.e a
	  SHA1 or a tag.

endif

config BR2_PACKAGE_OPTEE_CLIENT_VERSION
	string
	default "origin/master"	if BR2_PACKAGE_OPTEE_CLIENT_LATEST
	default BR2_PACKAGE_OPTEE_CLIENT_CUSTOM_REPO_VERSION \
				if BR2_PACKAGE_OPTEE_CLIENT_CUSTOM_GIT


config BR2_PACKAGE_OPTEE_CLIENT_TEE_FS_PATH
	string "Path for normal world OS secure storage"
	default "/data/tee"
	help
	  Path to storage area for secure storage based on the
	  normal world OS providing the actual storage via
	  tee-supplicant.

endif

comment "optee-client needs a toolchain w/ threads, dynamic library, headers >= 4.3"
	depends on !BR2_TOOLCHAIN_HAS_THREADS || BR2_STATIC_LIBS || \
		!BR2_TOOLCHAIN_HEADERS_AT_LEAST_4_3
```

## package/optee-examples/Config.in
```kconfig
config BR2_PACKAGE_OPTEE_EXAMPLES
	bool "optee-examples"
	depends on BR2_TARGET_OPTEE_OS
	depends on BR2_TOOLCHAIN_HAS_THREADS # optee-client
	depends on !BR2_STATIC_LIBS # optee-client
	depends on BR2_TOOLCHAIN_HEADERS_AT_LEAST_4_3 # optee-client
	select BR2_PACKAGE_OPTEE_CLIENT
	select BR2_TARGET_OPTEE_OS_SDK
	help
	  Enable the OP-TEE examples package that brings examples of
	  implementation of OP-TEE non-secure client applications and
	  secure trusted applications. OP-TEE examples is a
	  component delivered by the OP-TEE project.

	  Trusted application binary files are installed in the target
	  directory /lib/optee_armtz as other trusted applications.
	  At runtime OP-TEE OS can load trusted applications from this
	  non-secure filesystem/directory into the secure world for
	  execution.

	  https://github.com/linaro-swg/optee_examples



if BR2_PACKAGE_OPTEE_EXAMPLES

choice
	prompt "OP-TEE Examples version"
	default BR2_PACKAGE_OPTEE_EXAMPLES_LATEST
	help
	  Select the version of OP-TEE OS you want to use

config BR2_PACKAGE_OPTEE_EXAMPLES_LATEST
	bool "origin/master"
	help
	  Use the latest release tag from the OP-TEE OS official Git
	  repository.

config BR2_PACKAGE_OPTEE_EXAMPLES_CUSTOM_GIT
	bool "Custom Git repository"
	help
	  Use a custom version fetched from a Git repository.

endchoice


if BR2_PACKAGE_OPTEE_EXAMPLES_CUSTOM_GIT

config BR2_PACKAGE_OPTEE_EXAMPLES_CUSTOM_REPO_URL
	string "URL of custom repository"
	depends on BR2_PACKAGE_OPTEE_EXAMPLES_CUSTOM_GIT
	help
	  Specific location of the reference source tree Git
	  repository.

config BR2_PACKAGE_OPTEE_EXAMPLES_CUSTOM_REPO_VERSION
	string "Custom repository version"
	depends on BR2_PACKAGE_OPTEE_EXAMPLES_CUSTOM_GIT
	help
	  Revision to use in the typical format used by Git, i.e a
	  SHA1 or a tag.

endif

config BR2_PACKAGE_OPTEE_EXAMPLES_VERSION
	string
	default "origin/master"	if BR2_PACKAGE_OPTEE_EXAMPLES_LATEST
	default BR2_PACKAGE_OPTEE_EXAMPLES_CUSTOM_REPO_VERSION \
				if BR2_PACKAGE_OPTEE_EXAMPLES_CUSTOM_GIT


endif

comment "optee-examples needs a toolchain w/ threads, dynamic library, headers >= 4.3"
	depends on BR2_TARGET_OPTEE_OS
	depends on !BR2_TOOLCHAIN_HAS_THREADS || BR2_STATIC_LIBS || \
		!BR2_TOOLCHAIN_HEADERS_AT_LEAST_4_3
```

## package/optee-rust-examples/Config.in
```kconfig
config BR2_PACKAGE_OPTEE_RUST_EXAMPLES
	bool "optee_rust_examples"
	help
	  https://github.com/apache/incubator-teaclave-trustzone-sdk

config BR2_PACKAGE_OPTEE_RUST_EXAMPLES_SITE
	string "OP-TEE Rust examples path"
	default ""
	help
	  The path to the source directory of OP-TEE Rust SDK

if BR2_PACKAGE_OPTEE_RUST_EXAMPLES

config BR2_PACKAGE_OPTEE_RUST_EXAMPLES_CROSS_COMPILE
	string "OP-TEE Rust examples cross compiler"
	default ""
	help
	  some help

config BR2_PACKAGE_OPTEE_RUST_EXAMPLES_TC_PATH_ENV
       string "OP-TEE Rust examples toolchain path"
       default ""
       help
         some help
endif
```
